#include "built_in.h"

extern sfr char  TFT_DP_Lo;
extern sfr char TFT_DP_Hi;
extern sfr sbit TFT_WR;
extern sfr sbit TFT_RD;
extern sfr sbit TFT_CS;
extern sfr sbit TFT_RS;
extern sfr sbit TFT_RST;


extern sfr char  TFT_DP_Lo_Direction;
extern sfr char  TFT_DP_Hi_Direction;
extern sfr  TFT_WR_Direction;
extern sfr  TFT_RD_Direction;
extern sfr  TFT_CS_Direction;
extern sfr  TFT_RS_Direction;
extern sfr  TFT_RST_Direction;


const unsigned int Black = 0;
const unsigned int Red = 63488;
const unsigned int Green = 2016;
const unsigned int Blue = 31;
const unsigned int White = 65535;
const unsigned int Purple = 61727;
const unsigned int Yellow = 65504;
const unsigned int Cyan = 2047;
const unsigned int d_gray = 21130;
const unsigned int l_gray = 31727;


const char FONT_8x8[784] = {
0x00,0x00,0x00,0x00,0x00,0x00,0x00,0x00, // space 0x20
0x30,0x78,0x78,0x30,0x30,0x00,0x30,0x00, // !
0x6C,0x6C,0x6C,0x00,0x00,0x00,0x00,0x00, // "
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0x22,0x77,0x7f,0x7f,0x3e,0x1c,0x08,0x00         //HEART use:�
};

const char FONT_16x16[3040]  = {
0x00,0x00,0x00,0x00,0x00,0x00,0x00,0x00,0x00,0x00,0x00,0x00,0x00,0x00,0x00,0x00,0x00,0x00,0x00,0x00,0x00,0x00,0x00,0x00,0x00,0x00,0x00,0x00,0x00,0x00,0x00,0x00, //  <Space>
0x00,0x00,0x00,0x00,0x07,0x00,0x0F,0x80,0x0F,0x80,0x0F,0x80,0x0F,0x80,0x0F,0x80,0x07,0x00,0x07,0x00,0x00,0x00,0x00,0x00,0x07,0x00,0x07,0x00,0x07,0x00,0x00,0x00, // !
0x00,0x00,0x0E,0x38,0x0E,0x38,0x0E,0x38,0x0E,0x38,0x06,0x30,0x00,0x00,0x00,0x00,0x00,0x00,0x00,0x00,0x00,0x00,0x00,0x00,0x00,0x00,0x00,0x00,0x00,0x00,0x00,0x00, // "
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0x00,0x00,0x00,0x00,0x1F,0x1C,0x3B,0x9C,0x39,0xDC,0x38,0xF8,0x00,0x00,0x00,0x00,0x00,0x00,0x00,0x00,0x00,0x00,0x00,0x00,0x00,0x00,0x00,0x00,0x00,0x00,0x00,0x00  // ~
};



void Write_Command(unsigned int Wcommand)
{
  TFT_RD = 1;
  TFT_RS = 0;
  TFT_DP_Hi = wcommand >> 8;
  TFT_DP_Lo = wcommand ;
  TFT_WR = 0;
  TFT_WR = 1;
}

void Write_Data(unsigned int Wdata)
{
  TFT_RD = 1;
  TFT_RS = 1 ;
  TFT_DP_Hi = Wdata >>8 ;
  TFT_DP_Lo = wdata;
  TFT_WR = 0;
  TFT_WR = 1 ;
}

void Write_Command_Data(unsigned int Wcommand,unsigned int Wdata)
{
   write_Command(Wcommand);
   Write_Data(Wdata);
}

void TFT_Set_Address(unsigned int PX1,unsigned int PY1,unsigned int PX2,unsigned int PY2)
{
  Write_Command_Data(68,(PX2 << 8) + PX1 );  //Column address start2
  Write_Command_Data(69,PY1);      //Column address start1
  Write_Command_Data(70,Py2);  //Column address end2
  Write_Command_Data(78,PX1);      //Column address end1
  Write_Command_Data(79,PY1);  //Row address start2
  Write_Command(34);
}

void TFT_Init()
{
        TFT_RD = 1;
        TFT_RST=1;
        delay_ms(5);
        TFT_RST=0;
        delay_ms(15);
        TFT_RST=1;
        delay_ms(15);
        TFT_CS =0;
        Write_Command_Data(0x0000,0x0001);
        Write_Command_Data(0x0003,0xA8A4);
        Write_Command_Data(0x000C,0x0000);
        Write_Command_Data(0x000D,0x800C);
        Write_Command_Data(0x000E,0x2B00);
        Write_Command_Data(0x001E,0x00B7);
        Write_Command_Data(0x0001,0x2B3F);
        Write_Command_Data(0x0002,0x0600);
        Write_Command_Data(0x0010,0x0000);
        Write_Command_Data(0x0011,0x6070);
        Write_Command_Data(0x0005,0x0000);
        Write_Command_Data(0x0006,0x0000);
        Write_Command_Data(0x0016,0xEF1C);
        Write_Command_Data(0x0017,0x0003);
        Write_Command_Data(0x0007,0x0233);
        Write_Command_Data(0x000B,0x0000);
        Write_Command_Data(0x000F,0x0000);
        Write_Command_Data(0x0041,0x0000);
        Write_Command_Data(0x0042,0x0000);
        Write_Command_Data(0x0048,0x0000);
        Write_Command_Data(0x0049,0x013F);
        Write_Command_Data(0x004A,0x0000);
        Write_Command_Data(0x004B,0x0000);
        Write_Command_Data(0x0044,0xEF95);
        Write_Command_Data(0x0045,0x0000);
        Write_Command_Data(0x0046,0x013F);
        Write_Command_Data(0x0030,0x0707);
        Write_Command_Data(0x0031,0x0204);
        Write_Command_Data(0x0032,0x0204);
        Write_Command_Data(0x0033,0x0502);
        Write_Command_Data(0x0034,0x0507);
        Write_Command_Data(0x0035,0x0204);
        Write_Command_Data(0x0036,0x0204);
        Write_Command_Data(0x0037,0x0502);
        Write_Command_Data(0x003A,0x0302);
        Write_Command_Data(0x003B,0x0302);
        Write_Command_Data(0x0023,0x0000);
        Write_Command_Data(0x0024,0x0000);
        Write_Command_Data(0x0025,0x8000);
        Write_Command_Data(0x004f,0x0000);
        Write_Command_Data(0x004e,0x0000);
        Write_Command(0x0022);
        TFT_CS =1;
}


unsigned int Set_color(unsigned int r,unsigned int g,unsigned int b)
{
  unsigned int temp;
  Hi(temp) = (R & 0xF8) | (G >> 5);
              G = (G & 0x1C);
  Lo(temp) = (G << 3) | (B >>3);
  return temp;
}


void TFT_Fill(unsigned int color)
{
  unsigned int i,j;
  TFT_CS  = 0;
  TFT_Set_Address(0,0,239,319);
  Write_Data(color);
  for(i = 0; i <= 319; i++)
  {
    for(j = 0; j <= 239; j++)
    {
        TFT_WR = 0;
        TFT_WR = 1;
    }
  }
  TFT_CS  = 1;
}


void TFT_Box(unsigned int x1,unsigned int y1,unsigned int x2,unsigned int y2,unsigned int color)
{
  unsigned int  i,j;
  TFT_CS  = 0;
  TFT_Set_Address(x1,y1,x2,y2);
  Write_Data(color);
  for(i = y1; i <= y2; i++)
  {
    for(j = x1; j <= x2; j++)
    {
        TFT_WR = 0;
        TFT_WR = 1;
    }
  }
  TFT_CS  = 1;
}


void TFT_Dot(unsigned int x,unsigned int y,unsigned int color)
{
  TFT_CS  = 0;
  TFT_Set_Address(x,y,x,y);
  Write_Data(color);
  TFT_CS = 1;
}

void TFT_Line(unsigned int x1,unsigned int y1,unsigned int x2,unsigned int y2,unsigned int color)
{
int x,y,addx,addy,dx,dy;
long P;
unsigned int i;

  dx = fabs(x2-x1);
  dy = fabs(y2-y1);
  x = x1;
  y = y1;

   if(X1 > x2)
   {
       addx = -1;
   }
   else
   {
       addx = 1;
   }

   if(y1 > y2)
   {
      addy = -1;
   }
   else
   {
      addy = 1;
   }


 if(dx >= dy)
 {

  P = (2*dy) - dx;

   for(i = 1; i <= (dx +1); i++)
   {

     TFT_dot(x,y,color);

     if(P < 0)
     {
         P = P + (2*dy);
         x = (x + addx);
     }
     else
     {
        P = P+(2*dy) - (2*dx);
        x = x + addx;
        y = y + addy;
     }
    }
  }
  else
  {
    P = (2*dx) - dy;

    for(i = 1; i <= (dy +1); i++)
    {

     TFT_dot(x,y,color);

     if(P<0)
     {
       P = P + (2*dx);
       y = y + addy;
     }
     else
     {
        P = P + (2*dx) - (2*dy);
        x = x + addx;
        y = y + addy;
     }
    }
   }
}

void TFT_H_Line(char x1,char x2,unsigned int y_pos,unsigned int color)
{
  TFT_Box(x1,y_pos,x2,y_pos+1,color);
}

void TFT_V_Line(unsigned int y1,unsigned int y2,char x_pos,unsigned int color)
{
  TFT_Box(x_pos,y1,x_pos+1,y2,color);
}

void TFT_Rectangle(unsigned int x1,unsigned int y1,unsigned int x2,unsigned int y2,unsigned int color)
{
  TFT_H_Line(x1,x2,y1,color);
  TFT_H_Line(x1,x2,y2,color);
  TFT_V_Line(y1,y2,x1,color);
  TFT_V_Line(y1,y2,x2,color);
}

void TFT_Circle(unsigned int x,unsigned int y,char radius,char fill,unsigned int color)
{
int a_,b_,P;
 a_ = 0;
 b_ = radius;
 P = 1 - radius;
 while (a_ <= b_)
 {
    if(fill == 1)
    {
         TFT_Box(x-a_,y-b_,x+a_,y+b_,color);
         TFT_Box(x-b_,y-a_,x+b_,y+a_,color);
    }
    else
    {
         TFT_Dot(a_+x, b_+y, color);
         TFT_Dot(b_+x, a_+y, color);
         TFT_Dot(x-a_, b_+y, color);
         TFT_Dot(x-b_, a_+y, color);
         TFT_Dot(b_+x, y-a_, color);
         TFT_Dot(a_+x, y-b_, color);
         TFT_Dot(x-a_, y-b_, color);
         TFT_Dot(x-b_, y-a_, color);
    }
    if (P < 0 )
    {
        P = (P + 3) + (2* a_);
        a_ ++;
    }
    else
    {
        P = (P + 5) + (2* (a_ - b_));
        a_ ++;
        b_ --;
    }
  }
}

void TFT_Char(char C,unsigned int x,unsigned int y,char DimFont,unsigned int Fcolor,unsigned int Bcolor)
{
const char *PtrFont;
unsigned int Cptrfont;
unsigned int font8x8[8];
unsigned int font16x16[16];
char k,i,print1,print2;
unsigned int print3,print4;

if(DimFont == 8)
{
     ptrfont = &Font_8x8;
     Cptrfont = (C-32)*8;
     ptrfont = ptrfont + Cptrfont;

     for(k = 0; k <= 7; k++)
     {
      font8x8[k] = *ptrfont;
      ptrFont++;
     }

     TFT_CS = 0;
     TFT_Set_Address(x,y,x+7,y+7);
     for(i = 0; i <= 7; i++)
     {
       for(k = 0; k <= 7; k++)
       {
          print1 = (font8x8[i] & 0x80);
          print2 = print1 >>7;
          if(print2 == 1)
          {
             Write_Data(Fcolor);
          }
          else
          {
             Write_Data(Bcolor);
          }
          font8x8[i] = font8x8[i] << 1;
       }
     }
     TFT_CS = 1;
}

else if(DimFont == 16)
{
     ptrfont = &Font_16x16;
     Cptrfont = (C-32)*32;
     ptrfont = ptrfont + Cptrfont;

     for(k = 0; k <= 15; k++)
     {
      font16x16[k] = *ptrfont;
      ptrFont++;
      font16x16[k] = (font16x16[k] << 8);
      font16x16[k] = font16x16[k] + *ptrfont;
      ptrFont++;
     }

     TFT_CS = 0;
     TFT_Set_Address(x,y,x+15,y+15);
     for(i = 0; i <= 15; i++)
     {
       for(k = 0; k <= 15; k++)
       {
        print3 = (font16x16[i] & 0x8000);
        print4 = print3 >>15;

        if(print4 == 1)
        {
           Write_Data(Fcolor);
        }
        else
        {
           Write_Data(Bcolor);
        }

        font16x16[i] = font16x16[i] << 1;
       }
     }
     TFT_CS = 1;
}

}


void TFT_Text(unsigned char* S,unsigned int x,unsigned int y,char DimFont,unsigned int Fcolor,unsigned int Bcolor)
{
  int lenght,cnt;
  char buffer[24];
  lenght = strlen(S);

  for(cnt = 0; cnt <= (lenght - 1); cnt++)
  {
    buffer[cnt] = S[cnt];
  }

  if(DimFont == 8)
  {
      for(cnt = 0; cnt <= (lenght - 1); cnt++)
      {
        TFT_Char(buffer[cnt],x,y,DimFont,Fcolor,Bcolor);
        x = x + 8;
      }
  }
  else if(DimFont == 16)
  {
      for(cnt = 0; cnt <= (lenght - 1); cnt++)
      {
        TFT_Char(buffer[cnt],x,y,DimFont,Fcolor,Bcolor);
        x = x + 16;
      }
  }
}


void TFT_Image(unsigned int pos_x,unsigned int pos_y,unsigned int dim_x,unsigned int dim_y,const unsigned int *picture){
    unsigned int x, y;

    TFT_CS  = 0;
    TFT_Set_Address(pos_x, pos_y, pos_x + dim_x - 1, pos_y + dim_y - 1);
    for(y = pos_y; y < (pos_y + dim_y); y++ ) {
        for(x = pos_x; x < (pos_x + dim_x); x++ ) {
            Write_Data(*picture++);
        }
    }
    TFT_CS = 1;
}
